## drivers/sensors/Kconfig
```kconfig
config SENSORS
	bool "Sensors Class Support"
	help
	  This option enables the sensor sysfs class in /sys/class/sensors.
	  You'll need this to do anything useful with sensorss. If unsure, say N.

config SENSORS_SSC
	bool "Enable Sensors Driver Support for SSC"
	help
	  Add support for sensors SSC driver.
	  This driver is used for exercising sensors use case,
	  time syncing with ADSP clock.

config SENSORS_CORE
        bool "Sensors Class Support"
        help
          This option enables the sensor sysfs class in /sys/class/sensors.
          You'll need this to do anything useful with sensorss. If unsure, say N.

config SENSORS_K2HH
	depends on I2C
	tristate "SENSORS_K2HH"
	default n
	help
	  Say Y here if you use SENSORS_K2HH.
	  This option enables accelerometer sensors using
	  STMicroelectronic K2HH device driver.

config SENSORS_K2HH_VDD
	depends on SENSORS_K2HH
	tristate "SENSORS_K2HH_VDD"
	default n
	help
	  Say Y here if you use SENSORS_K2HH.
	  This option enables accelerometer sensors using
	  STMicroelectronic K2HH device driver with VDD control.

config SENSORS_STK3013
	depends on I2C
	tristate "STK3013 driver"
	default n
	help
	   This option enables proximity sensors using STK3013 driver.

config SENSORS_CM36655
	depends on I2C
	tristate "CM36655 driver"
	default n
	help
	  This option enables proximity & light sensors using CM36655 driver.

config SENSOR_CM36655_VIO
	depends on I2C
	tristate "CM36655 vio controlled"
	default n
	help
	  This option controll vio.

config SENSORS_CM36655_LEDA_EN_GPIO
	depends on I2C
	tristate "CM36655 leda_en controlled by GPIO"
	default n
	help
	  This option enables leda_en controlled by GPIO using CM36655 driver.

config SENSORS_CM36686
	depends on I2C
	tristate "CM36686 driver"
	default n
	help
	  This option enables proximity & light sensors using CM36686 driver.

config SENSORS_CM36686_LEDA_EN_GPIO
	depends on I2C
	tristate "CM36686 leda_en controlled by GPIO"
	default n
	help
	  This option enables leda_en controlled by GPIO using CM36686 driver.

config SENSORS_AK09911C
	tristate "AK09911C compass support"
	default n
	depends on I2C
	help
	  If you say yes here you get support for Asahi Kasei's
	  orientation sensor AK09911C.

config SENSORS_AK09916C
	tristate "AK09916C compass support"
	default n
	depends on I2C
	help
	  If you say yes here you get support for Asahi Kasei's
	  orientation sensor AK09916C.

config SENSORS_SW_RESET
	tristate "SENSOR SW RESET support"
	default n
	depends on I2C
	help
	  If you say yes here you get support for SENSOR SW RESET.
	  
config SENSORS_TMD3700
	depends on I2C
	tristate "TMD3700 driver"
	default n
	help
	   This option enables proximity & light sensors using TMD3700 driver.

config SENSORS_TMD3700_RESET_DEFENCE_CODE
	depends on I2C
	tristate "TMD3700 defence code for reset"
	default n
	help
	  This option enables defence code for reset of VDD.

config SENSORS_SX9310
	depends on I2C
	tristate "SX9310 driver"
	default n
	help
	  Say Y here if you use sx9310.
	  This option enables grip sensors using
	  SemTech sx9310 device driver.

	  Say N here if you do not use sx9310.

config SENSORS_YAS539
	tristate "YAS539 Sensor Driver"
	depends on I2C
	default n
	help
	  If you say yes here you get support for YAMAHA
	  YAS539 Geomagnitor Sensor.

config SENSORS_YAS_RESET_DEFENCE_CODE
	depends on I2C
	tristate "YAS defence code by reset"
	default n
	help
	  This option enables defence code by reset using yas driver.

config SENSORS_YAS539_DEFAULT_MATRIX
	depends on SENSORS_YAS539
	tristate "The default conpensation matrix for YAS539 softiron"
	default n
	help
	  This option is enables the default matrix for YAS539.
```

## drivers/video/msm/mdss/samsung/Kconfig
```kconfig
config SAMSUNG_DEBUG_DISPLAY
    bool "Add Samsung Debugging code"
    default n

config FB_MSM_MDSS_SAMSUNG
	depends on FB_MSM_MDSS
	bool "mdss config for samsung product"
	default n
	---help---
	Mdss config signature for samsung product

#
#	PANEL UNIQUE FEATURE
#
config DUAL_PANEL
	depends on FB_MSM_MDSS_SAMSUNG
	bool "dual paneloperation"
	default n
	---help---
	dual panel operation support

config PARTIAL_UPDATE
	depends on FB_MSM_MDSS_SAMSUNG
	bool "partial update operation"
	default n
	---help---
	partial update operation support

config CABC_FUNCTION
	depends on FB_MSM_MDSS_SAMSUNG
	bool "DDI cabc operation"
	default n
	---help---
	DDI cabc operation support

#
#	HOW TO MAKE DEF-CONFIG NAME FOR PANEL
#
#	PANEL_DDI-model_PANEL-model_RESOLUTION
#	PANEL_S6E3FA2    _AMS510CV01_FHD
#	PANEL_S6E3FA2_AMS510CV01_FHD
#

config PANEL_SC7798D_BV038WVM_WVGA
	depends on FB_MSM_MDSS_SAMSUNG
	bool "SITRONIX SC7798D LDI"
	default n
	---help---
	SITRONIX SC7798D LDI 480_800

config PANEL_S6E3HF4_AMB526JS01_WQHD
	depends on FB_MSM_MDSS_SAMSUNG
	bool "LSI S6E3HF4 LDI"
	default n
	---help---
	LSI S6E3HF4 LDI 1440_2560 HERO DSC

config PANEL_S6E3HA2_AMS509ES01_WQHD
	depends on FB_MSM_MDSS_SAMSUNG
	bool "LSI S6E3HA2 LDI"
	default n
	---help---
	LSI S6E3HF2 LDI 1440_2560 HERO DUAL (ZERO)

config PANEL_S6E3HA3_AMS567JA01_WQHD
	depends on FB_MSM_MDSS_SAMSUNG
	bool "LSI S6E3HA3 LDI"
	default n
	---help---
	LSI S6E3HA3 LDI 1440_2560 HERO DSC TEST

config PANEL_S6E3FA3_AMS568HN31_FHD
	depends on FB_MSM_MDSS_SAMSUNG
	bool "LSI S6E3FA3 LDI"
	default n
	---help---
	LSI S6E3FA3 LDI 1080_1920 C7

config PANEL_S6E3FA3_AMS598KH01_FHD
	depends on FB_MSM_MDSS_SAMSUNG
	bool "LSI S6E3FA3 LDI"
	default n
	---help---
	LSI S6E3FA3 LDI 1080_1920 A9

config PANEL_HX83100A_C5001H3F_HD
	depends on FB_MSM_MDSS_SAMSUNG
	bool "HIMAX HX83100A LDI"
	default n
	---help---
	HIMAX HX83100A LDI 720_1280 IN_CELL

config PANEL_TD4100_C5001H3F_HD
	depends on FB_MSM_MDSS_SAMSUNG
	bool "SYNAPTICS TD4100 LDI"
	default n
	---help---
	SYNAPTICS TD4100 LDI 720_1280 IN_CELL

config PANEL_TD4300_BS055FHM_FHD
	depends on FB_MSM_MDSS_SAMSUNG
	bool "SYNAPTICS TD4300 LDI"
	default n
	---help---
	SYNAPTICS TD4300 LDI 1080_1920 IN_CELL

config BLIC_ISL98611
	depends on FB_MSM_MDSS_SAMSUNG
	bool "BLIC ISL98611"
	default n
	---help---
	BLIC ISL98611
```
